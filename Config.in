## Config.in
```kconfig
source "$BR2_EXTERNAL_OKDO_C100_PATH/package/tegra210-firmware/Config.in"
source "$BR2_EXTERNAL_OKDO_C100_PATH/package/mesa3d-nvk/Config.in"
source "$BR2_EXTERNAL_OKDO_C100_PATH/package/whisper-cpp/Config.in"
source "$BR2_EXTERNAL_OKDO_C100_PATH/package/opencv4-vkstereo/Config.in"
```

## configs/okdo_c100_defconfig
```kconfig
BR2_aarch64=y
BR2_cortex_a57=y
BR2_TOOLCHAIN_EXTERNAL=y
BR2_TOOLCHAIN_EXTERNAL_BOOTLIN=y
BR2_TOOLCHAIN_EXTERNAL_BOOTLIN_AARCH64_GLIBC_STABLE=y
BR2_GLOBAL_PATCH_DIR="$(BR2_EXTERNAL_OKDO_C100_PATH)/patches"
BR2_TARGET_GENERIC_HOSTNAME="c100"
BR2_TARGET_GENERIC_ISSUE="Welcome to the OKdo Nano C100"
BR2_ROOTFS_DEVICE_CREATION_DYNAMIC_EUDEV=y
BR2_TARGET_GENERIC_GETTY_PORT="ttyS0"
BR2_SYSTEM_DHCP="eth0"
BR2_ROOTFS_OVERLAY="$(BR2_EXTERNAL_OKDO_C100_PATH)/board/okdo_c100/rootfs_overlay"
BR2_ROOTFS_POST_BUILD_SCRIPT="$(BR2_EXTERNAL_OKDO_C100_PATH)/board/okdo_c100/post-build.sh"
BR2_ROOTFS_POST_IMAGE_SCRIPT="$(BR2_EXTERNAL_OKDO_C100_PATH)/board/okdo_c100/post-image.sh"
BR2_LINUX_KERNEL=y
BR2_LINUX_KERNEL_CUSTOM_VERSION=y
BR2_LINUX_KERNEL_CUSTOM_VERSION_VALUE="6.18.57"
BR2_LINUX_KERNEL_PATCH="$(BR2_EXTERNAL_OKDO_C100_PATH)/board/okdo_c100/linux"
BR2_LINUX_KERNEL_USE_CUSTOM_CONFIG=y
BR2_LINUX_KERNEL_CUSTOM_CONFIG_FILE="$(BR2_EXTERNAL_OKDO_C100_PATH)/board/okdo_c100/linux/linux-6.18.defconfig"
BR2_LINUX_KERNEL_DTS_SUPPORT=y
BR2_LINUX_KERNEL_CUSTOM_DTS_PATH="$(BR2_EXTERNAL_OKDO_C100_PATH)/board/okdo_c100/linux/tegra210-p3448-0002-okdo-c100.dts"
BR2_LINUX_KERNEL_NEEDS_HOST_OPENSSL=y
BR2_PACKAGE_BUSYBOX_CONFIG_FRAGMENT_FILES="$(BR2_EXTERNAL_OKDO_C100_PATH)/board/okdo_c100/busybox.fragment"
BR2_PACKAGE_ALSA_UTILS=y
BR2_PACKAGE_ALSA_UTILS_APLAY=y
BR2_PACKAGE_LINUX_FIRMWARE=y
BR2_PACKAGE_LINUX_FIRMWARE_RTL_8169=y
BR2_PACKAGE_MESA3D=y
BR2_PACKAGE_MESA3D_GALLIUM_DRIVER_TEGRA=y
BR2_PACKAGE_MESA3D_GBM=y
BR2_PACKAGE_MESA3D_OPENGL_EGL=y
BR2_PACKAGE_MESA3D_OPENGL_ES=y
BR2_PACKAGE_MESA3D_VULKAN_DRIVER_NOUVEAU=y
BR2_PACKAGE_KMSCUBE=y
BR2_PACKAGE_FFMPEG=y
BR2_PACKAGE_FFMPEG_GPL=y
BR2_PACKAGE_FFMPEG_FFMPEG=y
BR2_PACKAGE_FFMPEG_FFPROBE=y
BR2_PACKAGE_X264=y
BR2_PACKAGE_VULKAN_TOOLS=y
BR2_PACKAGE_PYTHON3=y
BR2_PACKAGE_PYTHON3_PY_PYC=y
BR2_PACKAGE_PYTHON3_BZIP2=y
BR2_PACKAGE_PYTHON3_CURSES=y
BR2_PACKAGE_PYTHON3_DECIMAL=y
BR2_PACKAGE_PYTHON3_READLINE=y
BR2_PACKAGE_PYTHON3_SQLITE=y
BR2_PACKAGE_PYTHON3_SSL=y
BR2_PACKAGE_PYTHON3_XZ=y
BR2_PACKAGE_PYTHON3_ZLIB=y
BR2_PACKAGE_PYTHON3_ZSTD=y
BR2_PACKAGE_OPENBLAS=y
BR2_PACKAGE_OPENBLAS_TARGET="CORTEXA57"
BR2_PACKAGE_PYTHON_NUMPY=y
BR2_PACKAGE_LLAMA_CPP=y
BR2_PACKAGE_LLAMA_CPP_TOOLS=y
BR2_PACKAGE_LLAMA_CPP_VULKAN=y
BR2_PACKAGE_OPENCV4=y
BR2_PACKAGE_OPENCV4_LIB_CALIB3D=y
BR2_PACKAGE_OPENCV4_LIB_IMGCODECS=y
BR2_PACKAGE_OPENCV4_LIB_PYTHON=y
BR2_PACKAGE_OPENCV4_LIB_VIDEOIO=y
BR2_PACKAGE_OPENCV4_WITH_JPEG=y
BR2_PACKAGE_OPENCV4_WITH_PNG=y
BR2_PACKAGE_OPENCV4_WITH_FFMPEG=y
BR2_PACKAGE_OPENCV4_WITH_V4L=y
BR2_PACKAGE_PYTHON_PIP=y
BR2_PACKAGE_CA_CERTIFICATES=y
BR2_PACKAGE_LIBCURL=y
BR2_PACKAGE_LIBCURL_CURL=y
BR2_PACKAGE_LIBDRM=y
BR2_PACKAGE_LIBDRM_NOUVEAU=y
BR2_PACKAGE_LIBDRM_TEGRA=y
BR2_PACKAGE_DROPBEAR=y
BR2_PACKAGE_E2FSPROGS=y
BR2_PACKAGE_E2FSPROGS_RESIZE2FS=y
BR2_PACKAGE_HTOP=y
BR2_PACKAGE_NTP=y
BR2_PACKAGE_NTP_NTPD=y
BR2_PACKAGE_UTIL_LINUX=y
BR2_PACKAGE_UTIL_LINUX_BINARIES=y
BR2_PACKAGE_UTIL_LINUX_PARTX=y
BR2_PACKAGE_TEGRA210_FIRMWARE=y
BR2_PACKAGE_OPENCV4_VKSTEREO=y
BR2_PACKAGE_LIBCAMERA=y
BR2_PACKAGE_LIBCAMERA_PYTHON=y
BR2_PACKAGE_LIBCAMERA_V4L2=y
BR2_PACKAGE_LIBCAMERA_PIPELINE_SIMPLE=y
BR2_PACKAGE_LIBEVENT=y
BR2_PACKAGE_WHISPER_CPP=y
BR2_PACKAGE_WHISPER_CPP_VULKAN=y
BR2_PACKAGE_IREE_RUNTIME=y
BR2_TARGET_ROOTFS_EXT2=y
BR2_TARGET_ROOTFS_EXT2_4=y
BR2_TARGET_ROOTFS_EXT2_SIZE="4G"
# BR2_TARGET_ROOTFS_TAR is not set
BR2_TARGET_UBOOT=y
BR2_TARGET_UBOOT_BUILD_SYSTEM_KCONFIG=y
BR2_TARGET_UBOOT_CUSTOM_VERSION=y
BR2_TARGET_UBOOT_CUSTOM_VERSION_VALUE="2026.07"
BR2_TARGET_UBOOT_PATCH="$(BR2_EXTERNAL_OKDO_C100_PATH)/board/okdo_c100/uboot"
BR2_TARGET_UBOOT_BOARD_DEFCONFIG="p3450-0000"
BR2_TARGET_UBOOT_CONFIG_FRAGMENT_FILES="$(BR2_EXTERNAL_OKDO_C100_PATH)/board/okdo_c100/uboot/uboot.fragment"
BR2_TARGET_UBOOT_NEEDS_DTC=y
BR2_TARGET_UBOOT_NEEDS_OPENSSL=y
BR2_TARGET_UBOOT_NEEDS_GNUTLS=y
BR2_PACKAGE_HOST_DOSFSTOOLS=y
BR2_PACKAGE_HOST_GENIMAGE=y
BR2_PACKAGE_HOST_MTOOLS=y
BR2_PACKAGE_HOST_UBOOT_TOOLS=y
```

## package/iree-runtime/Config.in
```kconfig
config BR2_PACKAGE_IREE_RUNTIME
	bool "iree-runtime"
	depends on BR2_aarch64 || BR2_x86_64
	depends on BR2_INSTALL_LIBSTDCPP
	depends on BR2_TOOLCHAIN_HAS_THREADS
	depends on !BR2_STATIC_LIBS # vulkan-loader, dlopen
	depends on BR2_TOOLCHAIN_GCC_AT_LEAST_9
	select BR2_PACKAGE_VULKAN_LOADER
	# Python bindings, which need NumPy and ml_dtypes
	select BR2_PACKAGE_PYTHON_ML_DTYPES if BR2_PACKAGE_PYTHON3 && \
		BR2_PACKAGE_PYTHON_NUMPY_ARCH_SUPPORTS
	help
	  The IREE runtime: loads and runs ML modules compiled ahead of
	  time by the IREE compiler on the build host, on Vulkan GPUs
	  and on the CPU. Installs iree-run-module and the other IREE
	  tools. With Python 3, also installs the iree.runtime
	  package.

	  Includes fixes for non-coherent device memory and the TLSF
	  pool allocator, needed on the Tegra X1.

	  https://iree.dev

comment "iree-runtime needs a dynamic toolchain w/ C++, threads, gcc >= 9"
	depends on BR2_aarch64 || BR2_x86_64
	depends on !BR2_INSTALL_LIBSTDCPP || !BR2_TOOLCHAIN_HAS_THREADS \
		|| BR2_STATIC_LIBS || !BR2_TOOLCHAIN_GCC_AT_LEAST_9
```

## package/opencv4-vkstereo/Config.in
```kconfig
config BR2_PACKAGE_OPENCV4_VKSTEREO
	bool "opencv4-vkstereo"
	depends on BR2_PACKAGE_OPENCV4
	depends on !BR2_STATIC_LIBS # vulkan-loader
	select BR2_PACKAGE_OPENCV4_LIB_CALIB3D
	select BR2_PACKAGE_OPENCV4_LIB_IMGPROC
	select BR2_PACKAGE_VULKAN_LOADER
	select BR2_PACKAGE_VULKAN_HEADERS
	help
	  cv::vkstereo::StereoSGM, semi-global stereo matching on
	  Vulkan compute with the semantics of Fixstars libSGM, built
	  as an OpenCV extra module. With the OpenCV Python bindings it
	  is available as cv2.vkstereo.
```

## package/whisper-cpp/Config.in
```kconfig
config BR2_PACKAGE_WHISPER_CPP
	bool "whisper-cpp"
	depends on BR2_INSTALL_LIBSTDCPP
	depends on BR2_USE_WCHAR
	depends on BR2_TOOLCHAIN_HAS_THREADS
	depends on BR2_TOOLCHAIN_GCC_AT_LEAST_9
	help
	  Speech recognition with OpenAI's Whisper models in C/C++,
	  on ggml. Installs whisper-cli, whisper-server and
	  whisper-bench, with ggml linked in statically.

	  https://github.com/ggml-org/whisper.cpp

if BR2_PACKAGE_WHISPER_CPP

config BR2_PACKAGE_WHISPER_CPP_VULKAN
	bool "Vulkan support"
	depends on !BR2_STATIC_LIBS # vulkan-loader
	select BR2_PACKAGE_VULKAN_LOADER
	select BR2_PACKAGE_SPIRV_HEADERS
	help
	  Enable ggml's Vulkan backend for GPU acceleration.

endif

comment "whisper-cpp needs a toolchain w/ C++, wchar, threads, and gcc >= 9"
	depends on !BR2_INSTALL_LIBSTDCPP || !BR2_USE_WCHAR \
		|| !BR2_TOOLCHAIN_HAS_THREADS \
		|| !BR2_TOOLCHAIN_GCC_AT_LEAST_9
```
